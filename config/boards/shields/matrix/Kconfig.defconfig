## config/boards/shields/matrix/Kconfig.defconfig
```kconfig
if SHIELD_MATRIX_LEFT

config ZMK_KEYBOARD_NAME
    default "Matrix"

config ZMK_SPLIT_ROLE_CENTRAL
    default y

endif

if SHIELD_MATRIX_LEFT || SHIELD_MATRIX_RIGHT

config ZMK_SPLIT_ROLE_CENTRAL
    default y

config ZMK_SPLIT
    default y

endif
```

## config/boards/shields/matrix/Kconfig.shield
```kconfig
config SHIELD_MATRIX_LEFT
    def_bool $(shields_list_contains,matrix_left)

config SHIELD_MATRIX_RIGHT
    def_bool $(shields_list_contains,matrix_right)
```
